## bsp/drivers/display/tga_display/Kconfig
```kconfig
config TGA_DISPLAY
    bool "Display that uses a tga file as framebuffer"
    depends on FILE_SYSTEM
    help
      Enable support for the tga display driver.
```

## bsp/drivers/display/tiff_display/Kconfig
```kconfig
config TIFF_DISPLAY
    bool "Display that uses a tiff file as framebuffer"
    depends on FILE_SYSTEM
    help
      Enable support for the tiff display driver.
```

## bsp/dts/bindings/tga_display/custom,tga-display.yaml
```yaml
description: A display driver that uses a tga file as framebuffer

compatible: "custom,tga-display"

include: display-controller.yaml

properties:
  framebuffer_path:
    type: string
    required: true
    description: |
      The path of the framebuffer tga file.
```

## bsp/dts/bindings/tiff_display/custom,tiff-display.yaml
```yaml
description: A display driver that uses a tiff file as framebuffer

compatible: "custom,tiff-display"

include: display-controller.yaml

properties:
  framebuffer_path:
    type: string
    required: true
    description: |
      The path of the framebuffer tiff file.
```

## west.yml
```yaml
manifest:
  self:
    path: cpu

  remotes:
    - name: zephyrproject-rtos
      url-base: https://github.com/zephyrproject-rtos

  projects:
    - name: zephyr
      remote: zephyrproject-rtos
      revision: 183444eed4dcf2ecf13a1de75504981ed3b11e11 # v4.2-branch
      import:
        # By using name-allowlist we can clone only the modules that are
        # strictly needed by the application.
        name-allowlist:
          - cmsis_6 # required by the ARM port
          - hal_nxp # required by IMXRT1176
          - lvgl
          - zcbor
          - mcumgr
          - littlefs
          - mbedtls
```
